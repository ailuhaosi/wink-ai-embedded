## esp32_firmware/sdkconfig.defaults
```kconfig
# System
CONFIG_ESP_MAIN_TASK_STACK_SIZE=8192
CONFIG_ESP_TIMER_SUPPORTS_ISR_DISPATCH_METHOD=y

# FreeRTOS
CONFIG_FREERTOS_HZ=1000
CONFIG_FREERTOS_USE_TRACE_FACILITY=y
CONFIG_FREERTOS_USE_STATS_FORMATTING_FUNCTIONS=y

# Task watchdog
CONFIG_ESP_TASK_WDT_INIT=y
CONFIG_ESP_TASK_WDT_TIMEOUT_S=5

# RMT (ultrasonic capture)
CONFIG_RMT_ENABLE_DEBUG_LOG=n
CONFIG_RMT_ISR_IRAM_SAFE=y

# GPIO (ISR-safe control funcs in IRAM)
CONFIG_GPIO_CTRL_FUNC_IN_IRAM=y
```
